#include <ESP8266WiFi.h>
#include <ESP_SSD1306.h>
#include <SPI.h>            // only for compilation
#include <Wire.h>
#include <Button.h>
#include <Adafruit_GFX.h>
#include <PubSubClient.h>
#include <FS.h>
#include <ArduinoJson.h>

#define BUTTON_PIN D2
#define PULLUP true
#define INVERT true
#define DEBOUNCE_MS 20

// not sure where OLED_RESET is used, but it MUST NOT be
// GPIO16, otherwise the esp8266 will stay in a zombie mode
// on wake up after deep sleep. Just make it use any free pin
#define OLED_RESET D8

#define PIN_SDA D7
#define PIN_SCL D6
#define I2C_ADDRESS 0x3c

#define HWX_LOGO_W 128
#define HWX_LOGO_H 49
#define OLED_WIDTH 128
#define OLED_HEIGHT 64

String mqttClientId = String("ESP8266Client-") + ESP.getChipId();

Button btn(BUTTON_PIN, PULLUP, INVERT, DEBOUNCE_MS);
ESP_SSD1306 oled(D8);

unsigned long pressedAtMillis;
unsigned long const interval = 5000;
unsigned long pressedForMillis;

char* mqttServer = new char;
char* motdTopic = new char;
char* statusTopic = new char;

//IPAddress mqttServer(192, 168, 99, 102);
WiFiClient wifiClient;
PubSubClient mqttClient(wifiClient);
char msg[50];

File configFile;

// hortonworks logo for a splash screen
byte img[] = { 0x0, 0x0, 0x0, 0x0, 0x0, 0x0, 0x0, 0x0, 0x0, 0x0, 0x0, 0x0, 0x0,
    0x0, 0x0, 0x0, 0x0, 0x0, 0x0, 0x0, 0x0, 0x0, 0x0, 0x0, 0x0, 0x0, 0x0, 0x1,
    0xe0, 0x0, 0x0, 0x0, 0x0, 0x0, 0x0, 0x0, 0x0, 0x0, 0x0, 0x0, 0x0, 0x0, 0x0,
    0x1, 0xfc, 0x0, 0x0, 0x0, 0x0, 0x0, 0x0, 0x0, 0x0, 0x0, 0x0, 0x0, 0x0, 0x0,
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    0x0, 0x0, 0x0 };

void splashLogo() {
  oled.clearDisplay();
  // center the logo
  oled.drawBitmap((OLED_WIDTH - HWX_LOGO_W) / 2, (OLED_HEIGHT - HWX_LOGO_H) / 2,
      img, HWX_LOGO_W, HWX_LOGO_H, WHITE);
  oled.display();
}

void setup() {
  Serial.begin(115200);

  Wire.begin(PIN_SDA, PIN_SCL);
  oled.begin(SSD1306_SWITCHCAPVCC, I2C_ADDRESS, true);
  displayOn();

  splashLogo();
  delay(2000);
  oled.clearDisplay();

  oled.setTextSize(1);
  oled.setTextColor(WHITE);
  oled.setCursor(0, 0);
  oled.setTextWrap(true);

  SPIFFS.begin();
  configFile = SPIFFS.open("/config.json", "r");

  if (!configFile) {
    Serial.println("/config.json file doesn't exist!");
    oled.println("/config.json file doesn't exist!");
    oled.display();
  } else {

    oled.println("Using a /config.json settings file");
    oled.display();
    size_t fileSize = configFile.size();

    uint8_t buf[fileSize];
    configFile.read(buf, fileSize);
    StaticJsonBuffer<256> jsonBuffer;
    JsonObject& root = jsonBuffer.parseObject((char*) buf);
    if (!root.success()) {
      oled.println("Failed to parse config");
      oled.display();
      delay(1000);
    } else {
      strcpy(mqttServer, root["mqtt_server"]);
      strcpy(motdTopic, root["motd_topic"]);
      strcpy(statusTopic, root["status_topic"]);

      oled.print("MQTT Server: ");
      oled.println(mqttServer);
      oled.display();
    }
  }

  configFile.close();

  mqttClient.setCallback(callback);

  displayOff();
}

void connectWiFi() {
  if (WiFi.status() == WL_CONNECTED) {
    return;
  }

  displayOn();

  WiFi.mode(WIFI_STA);

  // Start SmartConfig if necessary
  if (WiFi.SSID() == "") {
    Serial.println("Beginning SmartConfig");
    oled.println("Beginning SmartConfig");
    oled.display();
    WiFi.beginSmartConfig();

    while (WiFi.status() != WL_CONNECTED) {
      delay(1000);
      Serial.print(".");
      oled.print(".");
      oled.display();
      if (WiFi.smartConfigDone()) {
        Serial.println();
        Serial.println("SmartConfig completed");
        oled.println();
        oled.println("SmartConfig completed");
        oled.display();
        WiFi.stopSmartConfig();
        delay(2000);
        break;
      }
    }
  } else {
    Serial.println(String("Using a saved SSID: ") + WiFi.SSID());
    oled.println(String("Using a saved SSID: ") + WiFi.SSID());
    oled.display();
  }

  Serial.print("Connecting..");
  oled.print("Connecting...");
  oled.display();

  WiFi.begin();
  unsigned int cnt = 0;
  while (WiFi.status() != WL_CONNECTED) {
    delay(1000);
    Serial.print(".");
    oled.print(".");
    oled.display();
    if (cnt++ == 30) {
      // wipe wifi info after 30 attempts
      // wifi ap may not be available anymore
      oled.clearDisplay();
      oled.println("Can't connect, resetting WiFi info");
      oled.display();
      WiFi.disconnect();
      ESP.restart();
      delay(3000);
    }
  }
  Serial.println("Ok");
  oled.println("Ok");
  oled.display();

  Serial.println(String("My IP: ") + WiFi.localIP().toString());
  oled.println(String("My IP: ") + WiFi.localIP().toString());
  oled.display();
  delay(3000);
}

void displayOff() {
  oled.ssd1306_command(SSD1306_DISPLAYOFF);
  oled.ssd1306_command(SSD1306_CHARGEPUMP);
  oled.ssd1306_command(SSD1306_SETHIGHCOLUMN);
}

void displayOn() {
  oled.ssd1306_command(SSD1306_CHARGEPUMP);
  oled.ssd1306_command(0x14);
  oled.ssd1306_command(SSD1306_DISPLAYON);
}

void loop() {
  btn.read();

  if (btn.wasPressed()) {
    pressedAtMillis = millis();
  }

  if (btn.wasReleased()) {
    if (pressedForMillis > interval) {
      // we have a long press, reset
      displayOn();
      Serial.println("Resetting WiFi credentials");
      oled.invertDisplay(true);
      oled.println("Resetting WiFi credentials");
      oled.display();
      WiFi.disconnect();

      delay(3000);
      ESP.restart();
    } else {
      // short press, turn on the display
      displayOn();
      splashLogo();
      oled.clearDisplay();
      delay(3000);
      // somewhere around mid-screen with this font and size
      oled.setCursor(0, 20);
      oled.println(String("My IP: ") + WiFi.localIP().toString());
      oled.println(String("MQTT Connected: ") + mqttClient.connected());
      if (mqttClient.connected()) {
        oled.println(String("Subscriber ID: ") + mqttClientId);
      }
      oled.display();
      delay(5000);
      oled.clearDisplay();
      oled.setCursor(0, 24);
      oled.println("Going to deep sleep");
      oled.display();
      displayOff();
      Serial.println("Going to deep sleep");
      delay(3000);
      // 5 minutes deep sleep
      ESP.deepSleep(60 * 5 * 1000 * 1000, RF_DEFAULT);
      delay(3000); // this will not really get executed
    }
  }

  pressedForMillis = millis() - pressedAtMillis;

  connectWiFi();

  if (!mqttClient.connected()) {
    reconnect();
  }
  mqttClient.loop();

  displayOff();
}

void callback(char* topic, byte* payload, unsigned int length) {
  Serial.print("Message arrived [");
  Serial.print(topic);
  Serial.print("] ");
  String text = "";
  for (int i = 0; i < length; i++) {
    //Serial.print((char) payload[i]);
    text += (char) payload[i];
  }
  Serial.println(text);

  oled.clearDisplay();
  displayOn();
  oled.display();
  oled.setCursor(0, 0);
  oled.println(text);
  oled.display();
  delay(4000);
  displayOff();
}

void reconnect() {
  mqttClient.setServer(mqttServer, 1883);
  // Loop until we're reconnected
  while (!mqttClient.connected()) {
    Serial.print("Attempting MQTT connection to ");
    Serial.print(mqttServer);
//    oled.print("Attempting MQTT connection ");
//    oled.display();

    // Attempt to connect
    boolean connected = mqttClient.connect(mqttClientId.c_str(),
                                           statusTopic, // will topic
                                           1, // qos
                                           true, // retain
                                           "offline"); // will message
    if (connected) {
      Serial.println(" connected");
      oled.println(" connected");
      // Once connected, publish an announcement...
      mqttClient.publish(statusTopic, "online");
      // ... and resubscribe
      mqttClient.subscribe(motdTopic);
    } else {
      Serial.print(" failed, rc=");
      Serial.print(mqttClient.state());
      Serial.println(" try again in 5 seconds");
      // Wait 5 seconds before retrying
      delay(5000);
    }
  }
}
